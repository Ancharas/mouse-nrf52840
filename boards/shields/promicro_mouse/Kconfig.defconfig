## boards/shields/promicro_mouse/Kconfig.defconfig
```kconfig
if SHIELD_PROMICRO_MOUSE

config ZMK_KEYBOARD_NAME
    default "ProMicro Mouse"

endif
```

## boards/shields/promicro_mouse/Kconfig.shield
```kconfig
config SHIELD_PROMICRO_MOUSE
    def_bool $(shields_list_contains,promicro_mouse)
```
