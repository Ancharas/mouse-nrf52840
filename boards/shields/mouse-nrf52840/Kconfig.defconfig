## boards/shields/mouse-nrf52840/Kconfig.defconfig
```kconfig
if SHIELD_MOUSE_NRF52840

# Name must be less than 16 characters long!
config ZMK_MOUSE_NRF52840
    default "Mouse NRF52840"

endif
```

## boards/shields/mouse-nrf52840/Kconfig.shield
```kconfig
config SHIELD_MOUSE_NRF52840
    def_bool $(shields_list_contains,mouse_nrf52840)
```
